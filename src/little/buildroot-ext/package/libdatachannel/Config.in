## src/little/buildroot-ext/package/libdatachannel/Config.in
```kconfig
config BR2_PACKAGE_LIBDATACHANNEL
	bool "libdatachannel"
	depends on BR2_TOOLCHAIN_HAS_THREADS
	select BR2_PACKAGE_USRSCTP
	select BR2_PACKAGE_LIBJUICE
	select BR2_PACKAGE_OPENSSL
	help
	  C/C++ WebRTC network library featuring Data Channels,
	  Media Transport, and WebSockets.

	  https://github.com/paullouisageneau/libdatachannel
```

## src/little/buildroot-ext/package/libjuice/Config.in
```kconfig
config BR2_PACKAGE_LIBJUICE
	bool "libjuice"
	depends on BR2_TOOLCHAIN_HAS_THREADS
	help
	  JUICE is a UDP Interactive Connectivity Establishment library.
	  A lightweight STUN/TURN client library for ICE.

	  https://github.com/paullouisageneau/libjuice
```

## src/little/buildroot-ext/package/usrsctp/Config.in
```kconfig
config BR2_PACKAGE_USRSCTP
	bool "usrsctp"
	depends on BR2_TOOLCHAIN_HAS_THREADS
	help
	  A portable SCTP userland stack.
	  Used by libdatachannel for WebRTC data channels.

	  https://github.com/sctplab/usrsctp
```
